## drivers/net/wireless/ath/Kconfig
```kconfig
menuconfig ATH_COMMON
	tristate "Atheros Wireless Cards"
	depends on CFG80211
	---help---
	  This will enable the support for the Atheros wireless drivers.
	  ath5k, ath9k, ath9k_htc and ar9170 drivers share some common code, this option
	  enables the common ath.ko module which shares common helpers.

	  For more information and documentation on this module you can visit:

	  http://wireless.kernel.org/en/users/Drivers/ath

	  For information on all Atheros wireless drivers visit:

	  http://wireless.kernel.org/en/users/Drivers/Atheros

if ATH_COMMON

config ATH_DEBUG
	bool "Atheros wireless debugging"
	---help---
	  Say Y, if you want to debug atheros wireless drivers.
	  Right now only ath9k makes use of this.

config ATH_DEFAULT_COUNTRY
	int "Default country code for Atheros cards"
	range 1 8191
	default "840"
	---help---
	  This allows you to specify a default country code for cards which
	  don't specify their country code and which indicate that the default
	  country should be used.
	  It has no effect on cards which _do_ specify the country code or
	  a (non-zero) regulatory domain.

	  If building for use in the USA, say "840".

source "drivers/net/wireless/ath/ath5k/Kconfig"
source "drivers/net/wireless/ath/ath9k/Kconfig"
source "drivers/net/wireless/ath/carl9170/Kconfig"

endif
```
